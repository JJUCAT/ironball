## software/ironball/components/ironball_server/Kconfig
```kconfig
menu "Jucat WiFi Manager"

    config SERVER_NAME
        string "server domain name"
        default "http://ironball.local"

    config SERVER_PORT
        int "server port"
        range 1024 49151
        default 2887

endmenu
```

## software/ironball/components/jucat_wifi_manager/Kconfig
```kconfig
menu "Jucat WiFi Manager"

    config WIFI_AP_SSID
        string "AP SSID"
        default "IronBall-AP"

    config WIFI_AP_PASSWORD
        string "AP password"
        default "12345678"

    config WIFI_AP_MAX_CONNECT
        int "Max STA connections"
        range 1 4
        default 4

    config WIFI_AP_DOMAIN
        string "AP domain name"
        default "ironball.config"

endmenu
```
